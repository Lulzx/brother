## esp32/sdkconfig.defaults
```kconfig
# ESP32-C3 settings
CONFIG_IDF_TARGET="esp32c3"

# WiFi
CONFIG_ESP_WIFI_SOFTAP_SUPPORT=n

# HTTP client
CONFIG_ESP_HTTP_CLIENT_ENABLE_HTTPS=y

# Stack sizes
CONFIG_ESP_MAIN_TASK_STACK_SIZE=4096

# Logging
CONFIG_LOG_DEFAULT_LEVEL_INFO=y
```
